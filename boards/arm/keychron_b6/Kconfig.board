## boards/arm/keychron_b6/Kconfig.board
```kconfig
config BOARD_KEYCHRON_B6
    bool "Keychron B6"
    depends on SOC_NRF52840_QIAA
```

## boards/shields/keychron_b6_us/Kconfig.shield
```kconfig
config SHIELD_KEYCHRON_B6_US
    def_bool $(shields_list_contains,keychron_b6_us)
```

## boards/vendor/keychron_b6/Kconfig.defconfig
```kconfig
if BOARD_KEYCHRON_B6

config ZMK_KEYBOARD_NAME
    default "Keychron B6"

if USB

config USB_NRFX
    default y

config USB_DEVICE_STACK
    default y

endif # USB

config BT_CTLR
    default BT

endif # BOARD_KEYCHRON_B6
```

## boards/vendor/keychron_b6/keychron_b6_defconfig
```kconfig
# Enable MPU
CONFIG_ARM_MPU=y

# Enable GPIO
CONFIG_GPIO=y

# Enable pinctrl
CONFIG_PINCTRL=y

# Place application at &code_partition address
CONFIG_USE_DT_CODE_PARTITION=y

# Generate a .uf2 firmware image
CONFIG_BUILD_OUTPUT_UF2=y

# Enable NVS for settings
CONFIG_MPU_ALLOW_FLASH_WRITE=y
CONFIG_NVS=y
CONFIG_SETTINGS_NVS=y
CONFIG_FLASH=y
CONFIG_FLASH_PAGE_LAYOUT=y
CONFIG_FLASH_MAP=y

# Enable ZMK BLE and USB output
CONFIG_ZMK_BLE=y
CONFIG_ZMK_USB=y

# Keychron USB identifiers
CONFIG_USB_DEVICE_VID=0x3434
CONFIG_USB_DEVICE_PID=0x0761
CONFIG_BT_DIS_PNP_VID=0x3434
CONFIG_BT_DIS_PNP_PID=0x0761
```
